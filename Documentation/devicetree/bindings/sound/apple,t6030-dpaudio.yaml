## Documentation/devicetree/bindings/sound/apple,t6030-dpaudio.yaml
```yaml
# SPDX-License-Identifier: (GPL-2.0-only OR BSD-2-Clause)
%YAML 1.2
---
$id: http://devicetree.org/schemas/sound/apple,t6030-dpaudio.yaml#
$schema: http://devicetree.org/meta-schemas/core.yaml#

title: Apple T6030 and T6041 DisplayPort audio

maintainers:
  - Ryan Murray <ryan@aurorasilicon.org>

description: |
  Each DisplayPort audio interface has no application-processor registers.
  Samples arrive through SIO, and the graph connects the interface to port 0
  of the display processor that owns its audio service. An interface without
  an assigned display processor has no graph connection and remains disabled.

  T6041 requires a generation-specific SIO firmware backend and a compatible
  display audio service before these interfaces can be enabled.

select:
  properties:
    compatible:
      contains:
        enum:
          - apple,t6030-dpaudio
          - apple,t6041-dpaudio
  required:
    - compatible

properties:
  compatible:
    items:
      - enum:
          - apple,t6030-dpaudio
          - apple,t6041-dpaudio
      - const: apple,dpaudio

  dmas:
    maxItems: 1

  dma-names:
    const: tx

  power-domains:
    maxItems: 1

  ports:
    $ref: /schemas/graph.yaml#/properties/ports
    properties:
      port@0:
        $ref: /schemas/graph.yaml#/properties/port
        description: Connection to the display processor's audio service.
    required:
      - port@0

required:
  - compatible
  - dmas
  - dma-names
  - power-domains

allOf:
  - if:
      properties:
        compatible:
          contains:
            const: apple,t6030-dpaudio
    then:
      required:
        - ports

  - if:
      not:
        required:
          - ports
    then:
      properties:
        status:
          const: disabled
      required:
        - status

additionalProperties: false
```
